## backports/Kconfig
```kconfig
config BACKPORT_INTEGRATE
	bool
	def_bool y

config BACKPORT_DIR
	string
	default "backports"

config BACKPORT_VERSION
	string
	default "v5.1.16-1-1-g67771ffe"

config BACKPORT_KERNEL_VERSION
	string
	default "v5.1.16-0-g8584aaf1c326"

config BACKPORT_KERNEL_NAME
	string
	default "Linux"

menuconfig BACKPORT_LINUX
	bool "Backport Linux v5.1.16-0-g8584aaf1c326 (backports v5.1.16-1-1-g67771ffe)"
	default n
	---help---
	  Enabling this will let give you the opportunity to use features and
	  drivers backported from Linux v5.1.16-0-g8584aaf1c326
	  on the kernel your are using. This is experimental and you should
	  say no unless you'd like to help test things or want to help debug
	  this should we run into any issues.

if BACKPORT_LINUX

source "$BACKPORT_DIR/Kconfig.versions"
source "$BACKPORT_DIR/Kconfig.sources"
# source "$BACKPORT_DIR/Kconfig.local"

endif # BACKPORT_LINUX
```

## backports/Kconfig.versions
```kconfig
config BACKPORT_KERNEL_4_5
    def_bool y
config BACKPORT_KERNEL_4_6
    def_bool y
config BACKPORT_KERNEL_4_7
    def_bool y
config BACKPORT_KERNEL_4_8
    def_bool y
config BACKPORT_KERNEL_4_9
    def_bool y
config BACKPORT_KERNEL_4_10
    def_bool y
config BACKPORT_KERNEL_4_12
    def_bool y
config BACKPORT_KERNEL_4_18
    def_bool y
config BACKPORT_KERNEL_4_19
    def_bool y
```

## backports/drivers/net/wireless/mediatek/mt76/Kconfig
```kconfig
config BACKPORT_MT76_CORE
	tristate
	depends on !MT76_CORE

config BACKPORT_MT76_LEDS
	bool
	depends on !MT76_LEDS
	depends on BACKPORT_MT76_CORE
	depends on LEDS_CLASS=y || BACKPORT_MT76_CORE=LEDS_CLASS
	default y

config BACKPORT_MT76_USB
	tristate
	depends on !MT76_USB
	depends on BACKPORT_MT76_CORE

config BACKPORT_MT76x02_LIB
	tristate
	depends on !MT76x02_LIB
	select BACKPORT_MT76_CORE

config BACKPORT_MT76x02_USB
	tristate
	depends on !MT76x02_USB
	select BACKPORT_MT76_USB

source "$BACKPORT_DIR/drivers/net/wireless/mediatek/mt76/mt76x0/Kconfig"
source "$BACKPORT_DIR/drivers/net/wireless/mediatek/mt76/mt76x2/Kconfig"
source "$BACKPORT_DIR/drivers/net/wireless/mediatek/mt76/mt7603/Kconfig"
```

## backports/drivers/net/wireless/mediatek/mt76/mt7603/Kconfig
```kconfig
config BACKPORT_MT7603E
	tristate "MediaTek MT7603E (PCIe) and MT76x8 WLAN support"
	depends on !MT7603E
	select BACKPORT_MT76_CORE
	depends on BACKPORT_MAC80211
	depends on PCI
	help
	  This adds support for MT7603E wireless PCIe devices and the BACKPORT_WLAN core on
	  MT7628/MT7688 SoC devices
```

## backports/drivers/net/wireless/mediatek/mt76/mt76x0/Kconfig
```kconfig
config BACKPORT_MT76x0_COMMON
	tristate
	depends on !MT76x0_COMMON
	select BACKPORT_MT76x02_LIB

config BACKPORT_MT76x0U
	tristate "MediaTek MT76x0U (USB) support"
	depends on !MT76x0U
	select BACKPORT_MT76x0_COMMON
	select BACKPORT_MT76x02_USB
	depends on BACKPORT_MAC80211
	depends on USB
	help
	  This adds support for MT7610U-based wireless USB dongles.

config BACKPORT_MT76x0E
	tristate "MediaTek MT76x0E (PCIe) support"
	depends on !MT76x0E
	select BACKPORT_MT76x0_COMMON
	depends on BACKPORT_MAC80211
	depends on PCI
	help
	  This adds support for MT7610/MT7630-based wireless PCIe devices.
```
